## examples/west.yml
```yaml
manifest:
  
  defaults:
    remote: alif

  remotes:
    - name: alif
      url-base: gitAlif:AlifSemi-Sirin
  
  projects:
    - name: zephyr
      repo-path: zephyr_alif_fork_4.1.git
      revision: tusb-porting
      import: true

  self:
    path: .
```
